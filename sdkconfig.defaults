## sdkconfig.defaults
```kconfig
# Custom partition table with spiffs for LittleFS storage
CONFIG_PARTITION_TABLE_CUSTOM=y
CONFIG_PARTITION_TABLE_CUSTOM_FILENAME="partitions.csv"
CONFIG_PARTITION_TABLE_FILENAME="partitions.csv"

# Flash size
CONFIG_ESPTOOLPY_FLASHSIZE_8MB=y

# Arduino core requirements
CONFIG_FREERTOS_HZ=1000

# Stack sizes - tuned for this app
CONFIG_ESP_MAIN_TASK_STACK_SIZE=8192
CONFIG_ESP_SYSTEM_EVENT_TASK_STACK_SIZE=2304
CONFIG_ESP_IPC_TASK_STACK_SIZE=1024
CONFIG_ESP_TIMER_TASK_STACK_SIZE=3584
CONFIG_ESP_MINIMAL_SHARED_STACK_SIZE=2048
CONFIG_ARDUINO_LOOP_STACK_SIZE=8192
CONFIG_ARDUINO_SERIAL_EVENT_TASK_STACK_SIZE=2048
CONFIG_ARDUINO_UDP_TASK_STACK_SIZE=4096

# BLE stack sizes - reduced for IRAM savings
CONFIG_BT_BTC_TASK_STACK_SIZE=3072
CONFIG_BT_BTU_TASK_STACK_SIZE=4352

# BLE GATT configuration
CONFIG_BT_GATT_MAX_SR_ATTRIBUTES=100
CONFIG_BT_GATT_MAX_SR_PROFILES=8
CONFIG_BT_GATTC_MAX_CACHE_CHAR=40

# HTTP Server - increase header buffer for browser cookies
CONFIG_HTTPD_MAX_REQ_HDR_LEN=1024

# IRAM savings - disable IRAM placement for non-critical drivers
# CONFIG_ADC_ONESHOT_CTRL_FUNC_IN_IRAM is not set
# CONFIG_ADC_CONTINUOUS_ISR_IRAM_SAFE is not set
# CONFIG_DAC_CTRL_FUNC_IN_IRAM is not set
# CONFIG_DAC_ISR_IRAM_SAFE is not set
# CONFIG_GPIO_CTRL_FUNC_IN_IRAM is not set
# CONFIG_GPTIMER_CTRL_FUNC_IN_IRAM is not set
# CONFIG_GPTIMER_ISR_IRAM_SAFE is not set
# CONFIG_I2C_ISR_IRAM_SAFE is not set
# CONFIG_I2S_ISR_IRAM_SAFE is not set
# CONFIG_LEDC_CTRL_FUNC_IN_IRAM is not set
# CONFIG_MCPWM_ISR_IRAM_SAFE is not set
# CONFIG_MCPWM_CTRL_FUNC_IN_IRAM is not set
# CONFIG_PCNT_CTRL_FUNC_IN_IRAM is not set
# CONFIG_PCNT_ISR_IRAM_SAFE is not set
# CONFIG_RMT_ISR_IRAM_SAFE is not set
# CONFIG_RMT_RECV_FUNC_IN_IRAM is not set
# CONFIG_SDM_CTRL_FUNC_IN_IRAM is not set
# CONFIG_SPI_MASTER_IN_IRAM is not set
# CONFIG_SPI_SLAVE_IN_IRAM is not set
# CONFIG_TOUCH_CTRL_FUNC_IN_IRAM is not set
# CONFIG_TOUCH_ISR_IRAM_SAFE is not set
# CONFIG_UART_ISR_IN_IRAM is not set
# CONFIG_ETH_IRAM_OPTIMIZATION is not set
# CONFIG_ESP_PANIC_HANDLER_IRAM is not set
# CONFIG_TWAI_ISR_IN_IRAM is not set

# Keep these in IRAM (needed for stability)
CONFIG_GPTIMER_ISR_HANDLER_IN_IRAM=y
CONFIG_SPI_MASTER_ISR_IN_IRAM=y
CONFIG_SPI_SLAVE_ISR_IN_IRAM=y
CONFIG_ESP_EVENT_POST_FROM_IRAM_ISR=y
CONFIG_PERIPH_CTRL_FUNC_IN_IRAM=y
CONFIG_ESP_SPI_BUS_LOCK_ISR_FUNCS_IN_IRAM=y

# ESP-SR configuration - load models from SD card
# CONFIG_MODEL_IN_FLASH is not set
CONFIG_MODEL_IN_SDCARD=y
CONFIG_USE_AFE=y
CONFIG_AFE_INTERFACE_V1=y
CONFIG_USE_WAKENET=y
CONFIG_SR_WN_WN9_HILEXIN=y
CONFIG_USE_MULTINET=y
CONFIG_SR_MN_EN_MULTINET6_QUANT=y

# PSRAM common settings (mode set per-target)
CONFIG_SPIRAM=y
CONFIG_SPIRAM_TYPE_AUTO=y
CONFIG_SPIRAM_USE_MALLOC=y
CONFIG_SPIRAM_MEMTEST=y
CONFIG_SPIRAM_MALLOC_ALWAYSINTERNAL=16384
CONFIG_SPIRAM_TRY_ALLOCATE_WIFI_LWIP=y
CONFIG_SPIRAM_MALLOC_RESERVE_INTERNAL=32768
CONFIG_SPIRAM_ALLOW_BSS_SEG_EXTERNAL_MEMORY=y
CONFIG_SPIRAM_ALLOW_NOINIT_SEG_EXTERNAL_MEMORY=y
```
