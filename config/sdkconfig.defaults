## experiments/board_qualification/camera_probe/p4/sdkconfig.defaults
```kconfig
CONFIG_FREERTOS_HZ=1000
CONFIG_ESP_MAIN_TASK_STACK_SIZE=12288
CONFIG_ESPTOOLPY_FLASHMODE_DIO=y
CONFIG_ESPTOOLPY_FLASHSIZE_16MB=y
CONFIG_ESP_CONSOLE_USB_SERIAL_JTAG=y
CONFIG_COMPILER_OPTIMIZATION_PERF=y
CONFIG_SPIRAM=y
CONFIG_SPIRAM_BOOT_INIT=y
CONFIG_SPIRAM_USE_MALLOC=y
CONFIG_SPIRAM_MALLOC_ALWAYSINTERNAL=16384
CONFIG_SPIRAM_MALLOC_RESERVE_INTERNAL=65536
CONFIG_ESP_REV_MIN_FULL=301
CONFIG_ESP_DEFAULT_CPU_FREQ_MHZ_400=y
CONFIG_SPIRAM_MODE_HEX=y
CONFIG_SPIRAM_SPEED_200M=y
CONFIG_CAMERA_OV2710=y
CONFIG_CAMERA_OV2710_MIPI_RAW10_1280X720_25FPS=y
CONFIG_CAMERA_OV2710_MIPI_DEFAULT_FMT_RAW10_1280X720_25FPS=y
CONFIG_CAMERA_SC2336=y
CONFIG_CAMERA_SC2336_AUTO_DETECT_MIPI_INTERFACE_SENSOR=y
CONFIG_CAMERA_XCLK_USE_ESP_CLOCK_ROUTER=y
CONFIG_ESP_VIDEO_ENABLE_MIPI_CSI_VIDEO_DEVICE=y
CONFIG_ESP_VIDEO_ENABLE_ISP_VIDEO_DEVICE=y
CONFIG_ESP_VIDEO_ENABLE_ISP_PIPELINE_CONTROLLER=y
CONFIG_ESP_VIDEO_ENABLE_DVP_VIDEO_DEVICE=n
CONFIG_ESP_VIDEO_ENABLE_SPI_VIDEO_DEVICE=n
CONFIG_ESP_VIDEO_ENABLE_USB_UVC_VIDEO_DEVICE=n
CONFIG_ESP_VIDEO_ENABLE_HW_H264_VIDEO_DEVICE=n
CONFIG_ESP_VIDEO_ENABLE_HW_JPEG_ENC_VIDEO_DEVICE=n
CONFIG_ESP_VIDEO_ENABLE_HW_JPEG_DEC_VIDEO_DEVICE=n
CONFIG_ESP_COREDUMP_ENABLE_TO_NONE=y
```

## experiments/board_qualification/camera_probe/s3/sdkconfig.defaults
```kconfig
CONFIG_FREERTOS_HZ=1000
CONFIG_ESP_MAIN_TASK_STACK_SIZE=12288
CONFIG_ESPTOOLPY_FLASHMODE_DIO=y
CONFIG_ESPTOOLPY_FLASHSIZE_16MB=y
CONFIG_ESP_CONSOLE_USB_SERIAL_JTAG=y
CONFIG_COMPILER_OPTIMIZATION_PERF=y
CONFIG_SPIRAM=y
CONFIG_SPIRAM_BOOT_INIT=y
CONFIG_SPIRAM_USE_MALLOC=y
CONFIG_SPIRAM_MALLOC_ALWAYSINTERNAL=16384
CONFIG_SPIRAM_MALLOC_RESERVE_INTERNAL=32768
CONFIG_ESP_DEFAULT_CPU_FREQ_MHZ_240=y
CONFIG_SPIRAM_MODE_OCT=y
CONFIG_SPIRAM_SPEED_80M=y
CONFIG_ESPTOOLPY_FLASHSIZE_8MB=y
CONFIG_CAMERA_JPEG_MODE_FRAME_SIZE_AUTO=y
CONFIG_CAMERA_PSRAM_DMA=n
```

## experiments/jpeg_portable/codec/sdkconfig.defaults
```kconfig
CONFIG_FREERTOS_HZ=1000
CONFIG_ESP_MAIN_TASK_STACK_SIZE=12288
CONFIG_ESPTOOLPY_FLASHMODE_DIO=y
CONFIG_ESPTOOLPY_FLASHSIZE_16MB=y
CONFIG_ESP_CONSOLE_USB_SERIAL_JTAG=y
CONFIG_COMPILER_OPTIMIZATION_PERF=y
CONFIG_SPIRAM=y
CONFIG_SPIRAM_BOOT_INIT=y
CONFIG_SPIRAM_USE_MALLOC=y
CONFIG_SPIRAM_MALLOC_ALWAYSINTERNAL=16384
CONFIG_SPIRAM_MALLOC_RESERVE_INTERNAL=32768
```

## experiments/p4_espnow/c6_programmer/sdkconfig.defaults
```kconfig
CONFIG_ESPTOOLPY_FLASHSIZE_16MB=y
CONFIG_ESP_CONSOLE_USB_SERIAL_JTAG=y
CONFIG_ESP32P4_SELECTS_REV_LESS_V3=n
CONFIG_ESP_MAIN_TASK_STACK_SIZE=8192
CONFIG_SERIAL_FLASHER_INTERFACE_UART=y
CONFIG_SERIAL_FLASHER_MD5_ENABLED=y
CONFIG_LOG_DEFAULT_LEVEL_WARN=y
```

## experiments/p4_espnow/hosted_p4/sdkconfig.defaults
```kconfig
CONFIG_IDF_TARGET="esp32p4"
CONFIG_ESPTOOLPY_FLASHSIZE_16MB=y
CONFIG_ESP32P4_SELECTS_REV_LESS_V3=n
CONFIG_ESP_CONSOLE_USB_SERIAL_JTAG=y
CONFIG_ESP_CONSOLE_SECONDARY_NONE=y
CONFIG_ESP_MAIN_TASK_STACK_SIZE=8192
CONFIG_FREERTOS_HZ=1000
CONFIG_LOG_DEFAULT_LEVEL_INFO=y
CONFIG_ESP_WIFI_REMOTE_ENABLED=y
CONFIG_ESP_WIFI_REMOTE_LIBRARY_HOSTED=y
CONFIG_SLAVE_IDF_TARGET_ESP32C6=y
CONFIG_ESP_HOSTED_ENABLED=y
CONFIG_ESP32P4_EYE_C6_BOARD=y
CONFIG_ESP_HOSTED_SDIO_HOST_INTERFACE=y
CONFIG_ESP_HOSTED_SDIO_SLOT_1=y
CONFIG_ESP_HOSTED_SDIO_4_BIT_BUS=y
CONFIG_ESP_HOSTED_SDIO_CLOCK_FREQ_KHZ=20000
CONFIG_ESP_HOSTED_PRIV_SDIO_PIN_CMD_SLOT_1=27
CONFIG_ESP_HOSTED_PRIV_SDIO_PIN_CLK_SLOT_1=28
CONFIG_ESP_HOSTED_PRIV_SDIO_PIN_D0_SLOT_1=29
CONFIG_ESP_HOSTED_PRIV_SDIO_PIN_D1_4BIT_BUS_SLOT_1=30
CONFIG_ESP_HOSTED_PRIV_SDIO_PIN_D2_4BIT_BUS_SLOT_1=31
CONFIG_ESP_HOSTED_PRIV_SDIO_PIN_D3_4BIT_BUS_SLOT_1=32
CONFIG_ESP_HOSTED_SDIO_GPIO_RESET_SLAVE=9
# Hosted's ACTIVE_HIGH means enabled-high, with a low reset pulse (see Kconfig).
CONFIG_ESP_HOSTED_SDIO_RESET_ACTIVE_HIGH=y
CONFIG_ESP_HOSTED_SLAVE_RESET_ON_EVERY_HOST_BOOTUP=y
CONFIG_ESP_HOSTED_SDIO_OPTIMIZATION_RX_STREAMING_MODE=y
CONFIG_ESP_HOSTED_ENABLE_PEER_DATA_TRANSFER=y
CONFIG_ESP_HOSTED_MAX_CUSTOM_MSG_HANDLERS=8
```

## experiments/p4_espnow/native_s3/sdkconfig.defaults
```kconfig
CONFIG_IDF_TARGET="esp32s3"
CONFIG_ESP_CONSOLE_USB_SERIAL_JTAG=y
CONFIG_ESP_CONSOLE_SECONDARY_NONE=y
CONFIG_ESP_MAIN_TASK_STACK_SIZE=6144
CONFIG_ESP_WIFI_NVS_ENABLED=n
CONFIG_LOG_DEFAULT_LEVEL_INFO=y

CONFIG_ESPTOOLPY_FLASHSIZE_8MB=y
```

## updater/main/Kconfig.projbuild
```kconfig
menu "HardwareOne recovery updater"

config HW1_UPDATER_AP_IP
    string "Recovery SoftAP IPv4 address"
    default "192.168.77.1"

config HW1_UPDATER_AP_CHANNEL
    int "Recovery SoftAP channel"
    range 1 13
    default 6

choice HW1_UPDATER_POWER_BACKEND
    prompt "Recovery power-sense backend"
    default HW1_UPDATER_POWER_GAUGE if IDF_TARGET_ESP32S3
    default HW1_UPDATER_POWER_ADC
    help
        How the recovery updater decides whether it is safe to start writing
        flash. This is a property of the board, so set it in
        updater/boards/<board>.defaults, not here.

    config HW1_UPDATER_POWER_GAUGE
        bool "VBUS sense GPIO + MAX17048 fuel gauge"
        help
            FeatherS3 class. A real USB-presence pin plus a gauge reporting
            true state-of-charge, so the interlock can be strict.

    config HW1_UPDATER_POWER_ADC
        bool "Battery voltage divider on ADC1, no USB sense"
        help
            Adafruit Feather ESP32 V2 class. The board exposes VBAT through a
            2:1 divider and NOTHING that reports USB presence -- see the
            comment in System_Battery.cpp: "the divider can't tell us whether
            VBUS is connected". The interlock is necessarily weaker here.

    config HW1_UPDATER_POWER_NONE
        bool "No power sensing (externally powered board)"
        help
            Adafruit QT Py ESP32 class: no battery connector, no gauge, no
            VBAT divider -- BATTERY_MONITOR_AVAILABLE is 0 for this board in
            System_BuildConfig.h. There is no measurement to take, so the
            interlock reports "external power" and allows the write. This is
            honest rather than permissive: a board with no cell that is
            executing code is on external power, and an interlock that
            refuses on absent telemetry would block recovery forever on
            exactly the hardware that can never produce it.
endchoice

config HW1_UPDATER_MIN_BATTERY_PERCENT
    int "Minimum battery percentage when USB is absent"
    depends on HW1_UPDATER_POWER_GAUGE
    range 1 100
    default 30

config HW1_UPDATER_BATTERY_ADC_CHANNEL
    int "ADC1 channel carrying VBAT/2"
    depends on HW1_UPDATER_POWER_ADC
    range 0 9
    default 7
    help
        Feather ESP32 V2: GPIO35 is ADC1 channel 7. Keep this in step with
        BATTERY_ADC_CHANNEL in components/hardwareone/System_Battery.h.

config HW1_UPDATER_BATTERY_DIVIDER_X100
    int "VBAT divider ratio, x100"
    depends on HW1_UPDATER_POWER_ADC
    range 100 1000
    default 200
    help
        200 means the pin sees VBAT/2. Matches VBAT_DIVIDER in
        components/hardwareone/System_Battery.h.

config HW1_UPDATER_MIN_BATTERY_MILLIVOLTS
    int "Minimum cell millivolts before a write is refused"
    depends on HW1_UPDATER_POWER_ADC
    range 3000 4200
    default 3600
    help
        Only applied when a cell actually appears to be attached (see
        HW1_UPDATER_BATTERY_ABSENT_MILLIVOLTS).

config HW1_UPDATER_BATTERY_ABSENT_MILLIVOLTS
    int "Reading below which no cell is considered attached"
    depends on HW1_UPDATER_POWER_ADC
    range 500 3000
    default 2500
    help
        A board that is executing this code is, by definition, powered. If the
        VBAT divider reads below this, no usable cell is attached and the power
        must be coming from USB -- so the write is ALLOWED. Refusing here would
        permanently block recovery on a mains-powered unit with no battery
        fitted, which is the exact deployment this backend exists for.

config HW1_UPDATER_IDLE_TIMEOUT_SEC
    int "Authenticated recovery idle timeout"
    range 60 86400
    default 900

config HW1_UPDATER_APPLY_TIMEOUT_SEC
    int "Maximum image receive/apply duration"
    range 60 3600
    default 600

config HW1_UPDATER_WDT_TIMEOUT_MS
    int "Updater control-task watchdog timeout"
    range 5000 60000
    default 15000

config HW1_UPDATER_HTTP_PORT
    int "Recovery HTTP port"
    range 1 65535
    default 80

endmenu
```
